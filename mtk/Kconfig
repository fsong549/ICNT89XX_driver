## mtk/Kconfig
```kconfig
config TOUCHSCREEN_CHIPONE
	tristate "Chipone Touchscreen for Mediatek package"
	depends on I2C
	default y
	help
	  Say y here if you have chipone touch panel.
		
	  If unsure, say N.

	  To compile this driver as a module, choose M here: the
	  module will be called chipone-ts.
```
